// main.cpp -- Personal Health Telemetry & ESP32 Edge-AI System
// Ties together: dummy sensor -> motion gate -> decision tree -> per-activity
// baselines -> CNN fall detector -> confirmation FSM -> risk engine -> JSON.
// Runs entirely on dummy data (no physical sensors required) per project spec §11.

#include <Arduino.h>
#include <math.h>
#include <string.h>
#include <WiFi.h>
#include <HTTPClient.h>
#include "config.h"
#include "dummy_sensor.h"
#include "activity_tree.h"     // generated by training/train_decision_tree.py
#include "motion_gate.h"
#include "baseline.h"
#include "fall_detector.h"
#include "risk_engine.h"

static uint32_t g_boot_time_ms = 0;
static void push_to_fastapi(const char* json_payload);  // forward decl, defined below
static uint32_t g_last_imu_ms = 0;
static uint32_t g_last_vitals_ms = 0;

// 1-second rolling buffer of raw IMU samples, used to build Decision Tree features.
static imu_sample_t g_feature_window[IMU_WINDOW_LEN];
static int g_feature_window_count = 0;

static float g_hr_accum = 0;
static float g_spo2_accum = 0;
static uint32_t g_vitals_count_for_avg = 0;

static uint32_t g_inactive_since_ms = 0;
static int g_last_activity_label = ACTIVITY_INACTIVE;

static void extract_features(const imu_sample_t *win, int n, float feat_out[6]) {
    float acc_sum = 0, acc_sq_sum = 0, acc_peak = 0;
    float gyro_sum = 0, gyro_sq_sum = 0;
    float acc_devsum = 0, gyro_devsum = 0;
    float acc_vals[IMU_WINDOW_LEN], gyro_vals[IMU_WINDOW_LEN];

    for (int i = 0; i < n; i++) {
        float am = sqrtf(win[i].acc_x * win[i].acc_x + win[i].acc_y * win[i].acc_y + win[i].acc_z * win[i].acc_z);
        float gm = sqrtf(win[i].gyro_x * win[i].gyro_x + win[i].gyro_y * win[i].gyro_y + win[i].gyro_z * win[i].gyro_z);
        acc_vals[i] = am; gyro_vals[i] = gm;
        acc_sum += am; gyro_sum += gm;
        if (am > acc_peak) acc_peak = am;
    }
    float acc_mean = acc_sum / n;
    float gyro_mean = gyro_sum / n;

    for (int i = 0; i < n; i++) {
        float da = acc_vals[i] - acc_mean;
        float dg = gyro_vals[i] - gyro_mean;
        acc_sq_sum += da * da;
        gyro_sq_sum += dg * dg;
        acc_devsum += fabsf(da);
        gyro_devsum += fabsf(dg);
    }
    float acc_var = acc_sq_sum / n;
    float gyro_var = gyro_sq_sum / n;
    float acc_std = sqrtf(acc_var);
    float gyro_std = sqrtf(gyro_var);

    // feature order must match training/train_decision_tree.py: FEATURE_NAMES
    feat_out[0] = acc_mean;
    feat_out[1] = gyro_mean;
    feat_out[2] = acc_var;
    feat_out[3] = gyro_var;
    feat_out[4] = acc_std + gyro_std; // movement_intensity
    feat_out[5] = acc_peak;
}

static void process_one_second_window() {
    float feat[6];
    extract_features(g_feature_window, g_feature_window_count, feat);

    activity_result_t act = classify_activity(feat);
    g_last_activity_label = act.label;

    if (act.label == ACTIVITY_INACTIVE) {
        if (g_inactive_since_ms == 0) g_inactive_since_ms = millis();
    } else {
        g_inactive_since_ms = 0;
    }

    uint32_t elapsed_s = (millis() - g_boot_time_ms) / 1000;
    bool low_conf = motion_gate_is_low_confidence(feat[2] /* acc_var */, act.label);

    float avg_hr = g_vitals_count_for_avg ? (g_hr_accum / g_vitals_count_for_avg) : 0;
    float avg_spo2 = g_vitals_count_for_avg ? (g_spo2_accum / g_vitals_count_for_avg) : 0;

    anomaly_result_t hr_result = { ANOMALY_NONE, 0, false };
    anomaly_result_t spo2_result = { ANOMALY_NONE, 0, false };

    if (!low_conf && g_vitals_count_for_avg > 0) {
        hr_result = baseline_process_hr(act.label, avg_hr, act.confidence, elapsed_s);
        spo2_result = baseline_process_spo2(act.label, avg_spo2, act.confidence, elapsed_s);
    }
    g_hr_accum = 0; g_spo2_accum = 0; g_vitals_count_for_avg = 0;

    fall_state_t fall_state = fall_detector_update();
    bool fall_confirmed_edge = false;
    static fall_state_t prev_fall_state = FALL_STATE_IDLE;
    if (fall_state == FALL_STATE_CONFIRMED && prev_fall_state != FALL_STATE_CONFIRMED) {
        fall_confirmed_edge = true;
    }
    prev_fall_state = fall_state;

    uint32_t inactive_duration_s = g_inactive_since_ms ? (millis() - g_inactive_since_ms) / 1000 : 0;

    risk_snapshot_t snap;
    snap.avg_hr = avg_hr;
    snap.avg_spo2 = avg_spo2;
    snap.activity_label = act.label;
    snap.activity_confidence = act.confidence;
    snap.hr_anomaly = (hr_result.type == ANOMALY_ACUTE);
    snap.spo2_anomaly = (spo2_result.type == ANOMALY_ACUTE);
    snap.trend_anomaly = (hr_result.type == ANOMALY_TREND) || (spo2_result.type == ANOMALY_TREND);
    snap.fall_detected = fall_confirmed_edge;
    snap.risk_score = risk_engine_score(snap.hr_anomaly, snap.spo2_anomaly, snap.trend_anomaly,
                                         snap.fall_detected, act.label, inactive_duration_s);

    const char *activity_names[NUM_ACTIVITY_STATES] = {
        "inactive", "resting", "running", "transition", "walking"
        // NOTE: order must match the ACTIVITY_* enum generated in activity_tree.h for your
        // trained tree -- verify against the generated file, since class order depends on
        // which labels were present in your training data.
    };
    const char *activity_name = (act.label >= 0 && act.label < NUM_ACTIVITY_STATES)
                                     ? activity_names[act.label] : "unknown";

    static char json_buf[512];
    int written = risk_engine_to_json(snap, activity_name, "user_001", json_buf, sizeof(json_buf));
    if (written > 0) {
        Serial.println(json_buf);          // keep for debugging
        push_to_fastapi(json_buf);
    }

    if (fall_confirmed_edge) {
        fall_detector_reset_after_alert();
    }
}

// Sends the JSON snapshot to the FastAPI backend over WiFi.
static void push_to_fastapi(const char* json_payload) {
    if (WiFi.status() != WL_CONNECTED) return;
    HTTPClient http;
    http.begin(FASTAPI_ENDPOINT);
    http.addHeader("Content-Type", "application/json");
    int code = http.POST(json_payload);
    Serial.printf("HTTP Response: %d\n", code);
    http.end();
}

static void connect_wifi() {
    WiFi.begin(WIFI_SSID, WIFI_PASSWORD);
    Serial.print("Connecting to WiFi");
    while (WiFi.status() != WL_CONNECTED) {
        delay(500);
        Serial.print(".");
    }
    Serial.println();
    Serial.println("WiFi connected!");
    Serial.println(WiFi.localIP());
}

void setup() {
    Serial.begin(SERIAL_BAUD);
    delay(500);
    randomSeed(analogRead(0));

    connect_wifi();

    g_boot_time_ms = millis();
    baseline_init();
    fall_detector_init();

    Serial.println("{\"status\":\"boot\",\"message\":\"Health telemetry pipeline initialized (dummy sensor mode)\"}");
}

void loop() {
    uint32_t now = millis();

    // IMU tick @ IMU_FS_HZ
    uint32_t imu_period_ms = 1000 / IMU_FS_HZ;
    if (now - g_last_imu_ms >= imu_period_ms) {
        uint32_t dt = now - g_last_imu_ms;
        g_last_imu_ms = now;

        imu_sample_t s = dummy_sensor_read_imu(dt);
        fall_detector_push_sample(s);

        if (g_feature_window_count < IMU_WINDOW_LEN) {
            g_feature_window[g_feature_window_count++] = s;
        }
    }

    // Vitals tick @ VITALS_FS_HZ
    uint32_t vitals_period_ms = 1000 / VITALS_FS_HZ;
    if (now - g_last_vitals_ms >= vitals_period_ms) {
        g_last_vitals_ms = now;
        vitals_sample_t v = dummy_sensor_read_vitals();
        g_hr_accum += v.heart_rate;
        g_spo2_accum += v.spo2;
        g_vitals_count_for_avg++;

        // Once we have a full 1-second IMU feature window, run the full pipeline.
        if (g_feature_window_count >= IMU_WINDOW_LEN) {
            process_one_second_window();
            g_feature_window_count = 0;
        }
    }
}