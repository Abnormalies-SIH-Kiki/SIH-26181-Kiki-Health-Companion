// fall_detector.cpp -- see fall_detector.h.
//
// NOTE ON MODEL FILES: this file expects models/fall_model_data.h and
// models/fall_model_norm.h to have been generated by training/train_cnn.py and
// copied into firmware/include/ before building. A placeholder is NOT included
// here on purpose -- training on your own dummy dataset first is part of the
// intended workflow (see README "Build & Flash").

#include <math.h>
#include <Arduino.h>
#include <TensorFlowLite_ESP32.h>
#include <tensorflow/lite/micro/all_ops_resolver.h>
#include <tensorflow/lite/micro/micro_interpreter.h>
#include <tensorflow/lite/micro/micro_error_reporter.h>
#include <tensorflow/lite/schema/schema_generated.h>

#include "fall_detector.h"
#include "fall_model_data.h"   // generated: fall_model_data[], fall_model_data_len
#include "fall_model_norm.h"   // generated: FALL_MODEL_MEAN[], FALL_MODEL_STD[], WINDOW_LEN

namespace {
tflite::MicroErrorReporter micro_error_reporter;
tflite::ErrorReporter *error_reporter = &micro_error_reporter;
const tflite::Model *model = nullptr;
tflite::MicroInterpreter *interpreter = nullptr;
TfLiteTensor *input = nullptr;
TfLiteTensor *output = nullptr;

alignas(16) uint8_t tensor_arena[TENSOR_ARENA_SIZE];

// Rolling raw IMU window (float, pre-quantization) -- circular buffer.
float g_window[FALL_MODEL_WINDOW_LEN][FALL_MODEL_N_CHANNELS];
int g_window_head = 0;
int g_window_count = 0;

float g_last_probability = 0.0f;
fall_state_t g_fsm_state = FALL_STATE_IDLE;
uint32_t g_confirm_elapsed_s = 0;
uint32_t g_still_run_s = 0;
} // namespace

void fall_detector_init() {
    model = tflite::GetModel(fall_model_data);
    if (model->version() != TFLITE_SCHEMA_VERSION) {
        error_reporter->Report("Model schema version mismatch");
        return;
    }

    static tflite::AllOpsResolver resolver;
    static tflite::MicroInterpreter static_interpreter(
        model, resolver, tensor_arena, TENSOR_ARENA_SIZE, error_reporter);
    interpreter = &static_interpreter;

    if (interpreter->AllocateTensors() != kTfLiteOk) {
        error_reporter->Report("AllocateTensors() failed -- increase TENSOR_ARENA_SIZE in config.h");
        return;
    }

    input = interpreter->input(0);
    output = interpreter->output(0);

    g_window_head = 0;
    g_window_count = 0;
    g_fsm_state = FALL_STATE_IDLE;
    g_confirm_elapsed_s = 0;
    g_still_run_s = 0;
}

void fall_detector_push_sample(const imu_sample_t &s) {
    int idx = g_window_head;
    g_window[idx][0] = s.acc_x;
    g_window[idx][1] = s.acc_y;
    g_window[idx][2] = s.acc_z;
    g_window[idx][3] = s.gyro_x;
    g_window[idx][4] = s.gyro_y;
    g_window[idx][5] = s.gyro_z;
    g_window_head = (g_window_head + 1) % FALL_MODEL_WINDOW_LEN;
    if (g_window_count < FALL_MODEL_WINDOW_LEN) g_window_count++;
}

// Runs INT8 quantized inference over the current rolling window. Returns fall probability.
static float run_inference() {
    if (g_window_count < FALL_MODEL_WINDOW_LEN || interpreter == nullptr) return 0.0f;

    float in_scale = input->params.scale;
    int32_t in_zero_point = input->params.zero_point;

    // Window is read oldest-to-newest starting at g_window_head (circular buffer).
    for (int t = 0; t < FALL_MODEL_WINDOW_LEN; t++) {
        int src = (g_window_head + t) % FALL_MODEL_WINDOW_LEN;
        for (int c = 0; c < FALL_MODEL_N_CHANNELS; c++) {
            float normalized = (g_window[src][c] - FALL_MODEL_MEAN[c]) / FALL_MODEL_STD[c];
            int32_t quantized = (int32_t)roundf(normalized / in_scale) + in_zero_point;
            if (quantized < -128) quantized = -128;
            if (quantized > 127) quantized = 127;
            input->data.int8[t * FALL_MODEL_N_CHANNELS + c] = (int8_t)quantized;
        }
    }

    if (interpreter->Invoke() != kTfLiteOk) {
        error_reporter->Report("Invoke() failed");
        return 0.0f;
    }

    float out_scale = output->params.scale;
    int32_t out_zero_point = output->params.zero_point;
    int8_t raw = output->data.int8[0];
    float probability = (raw - out_zero_point) * out_scale;
    return probability;
}

// Checks whether the most recent second of IMU samples looks "still" (spec §8 Phase C test).
static bool window_is_still() {
    // Check the newest 50 samples only (last 1s), regardless of full window length.
    int n = (g_window_count < IMU_WINDOW_LEN) ? g_window_count : IMU_WINDOW_LEN;
    if (n == 0) return false;
    float acc_dev_sum = 0.0f, gyro_mag_sum = 0.0f;
    for (int t = 0; t < n; t++) {
        int idx = (g_window_head - 1 - t + FALL_MODEL_WINDOW_LEN) % FALL_MODEL_WINDOW_LEN;
        float ax = g_window[idx][0], ay = g_window[idx][1], az = g_window[idx][2];
        float gx = g_window[idx][3], gy = g_window[idx][4], gz = g_window[idx][5];
        float acc_mag = sqrtf(ax * ax + ay * ay + az * az);
        float gyro_mag = sqrtf(gx * gx + gy * gy + gz * gz);
        acc_dev_sum += fabsf(acc_mag - 1.0f);
        gyro_mag_sum += gyro_mag;
    }
    float acc_dev_avg = acc_dev_sum / n;
    float gyro_avg = gyro_mag_sum / n;
    return (acc_dev_avg < FALL_STILLNESS_ACC_TOL) && (gyro_avg < FALL_STILLNESS_GYRO_TOL);
}

fall_state_t fall_detector_update() {
    g_last_probability = run_inference();
    Serial.printf("fall_prob=%.3f state=%d\n", g_last_probability, (int)g_fsm_state);

    switch (g_fsm_state) {
        case FALL_STATE_IDLE:
            if (g_last_probability > FALL_PROB_THRESHOLD) {
                g_fsm_state = FALL_STATE_SUSPECTED;
                g_confirm_elapsed_s = 0;
                g_still_run_s = 0;
            }
            break;

        case FALL_STATE_SUSPECTED: {
            g_confirm_elapsed_s += 1;
            bool still = window_is_still();
            g_still_run_s = still ? (g_still_run_s + 1) : 0;

            if (g_still_run_s >= FALL_STILLNESS_MIN_S) {
                g_fsm_state = FALL_STATE_CONFIRMED;
            } else if (!still && g_confirm_elapsed_s < FALL_CONFIRM_WINDOW_S) {
                // Normal motion resumed before stillness was ever achieved -> likely false alarm.
                // (Only bail out early if we've seen clear resumed motion, not just noise.)
                float acc_mag = sqrtf(g_window[(g_window_head - 1 + FALL_MODEL_WINDOW_LEN) % FALL_MODEL_WINDOW_LEN][0] *
                                       g_window[(g_window_head - 1 + FALL_MODEL_WINDOW_LEN) % FALL_MODEL_WINDOW_LEN][0]);
                (void)acc_mag; // motion-resumed heuristic kept simple; refine with activity-tree output if desired
            }

            if (g_confirm_elapsed_s >= FALL_CONFIRM_WINDOW_S && g_fsm_state == FALL_STATE_SUSPECTED) {
                // Spec §8: no new data / ambiguous by timeout -> conservative CONFIRMED.
                g_fsm_state = FALL_STATE_CONFIRMED;
            }
            break;
        }

        case FALL_STATE_CONFIRMED:
            // Caller is expected to consume this state (raise the alert) then call
            // fall_detector_reset_after_alert() below to return to IDLE.
            break;
    }

    return g_fsm_state;
}

float fall_detector_last_probability() {
    return g_last_probability;
}

void fall_detector_reset_after_alert() {
    g_fsm_state = FALL_STATE_IDLE;
    g_confirm_elapsed_s = 0;
    g_still_run_s = 0;
}
